## drivers/sensor/hw_revision/Kconfig
```kconfig
# Copyright (c) 2024 Nordic Semiconductor ASA
# SPDX-License-Identifier: Apache-2.0

menuconfig HW_REVISION
	bool "Hardware revision detection drivers"
	help
	  This option enables the hardware revision detection custom driver.

if HW_REVISION

config HW_REVISION_INIT_PRIORITY
	int "Hardware revision device drivers init priority"
	default KERNEL_INIT_PRIORITY_DEVICE
	help
	  Hardware revision device drivers init priority.

module = HW_REVISION
module-str = hw-revision
source "subsys/logging/Kconfig.template.log_config"

endif # HW_REVISION
```

## dts/bindings/sensor/hw-revision.yaml
```yaml
# Copyright (c) 2024 Thorsten Spätling <thorsten.spaetling@vierling.de>
# SPDX-License-Identifier: Apache-2.0

description: |
  An example sensor that reads the GPIO level defined in input-gpios. The
  purpose of this sensor is to demonstrate how to create out-of-tree drivers.

  Example definition in devicetree:

    hw-revision {
        compatible = "hw-revision";
        hw_rev_pin_0 {
                input-gpios = <&gpio0 0 (GPIO_PULL_UP | GPIO_ACTIVE_LOW)>;
        };
        hw_rev_pin_1 {
                input-gpios = <&gpio0 1 (GPIO_PULL_DOWN | GPIO_ACTIVE_HIGH)>;
        };
    };

compatible: "hw-revision"

include: base.yaml

child-binding:
  properties:
    gpios:
      type: phandle-array
      required: true
      description: Input GPIO to be sensed.
```
